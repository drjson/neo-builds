## Config.in
```kconfig
source "$BR2_EXTERNAL_NEO_BLD_PATH/package/dump1090/Config.in"
source "$BR2_EXTERNAL_NEO_BLD_PATH/package/kalibrate-rtl/Config.in"
source "$BR2_EXTERNAL_NEO_BLD_PATH/package/acarsdec/Config.in"
source "$BR2_EXTERNAL_NEO_BLD_PATH/package/mlat-client/Config.in"
```

## configs/neo_sdrhost_defconfig
```kconfig
BR2_arm=y
BR2_cortex_a9=y
BR2_ARM_ENABLE_NEON=y
BR2_ARM_ENABLE_VFP=y
BR2_ARM_FPU_VFPV3=y
BR2_CCACHE=y
BR2_GLOBAL_PATCH_DIR="$(BR2_EXTERNAL_NEO_BLD_PATH)/board/udoo/neo_latest/patches"
BR2_TOOLCHAIN_BUILDROOT_LOCALE=y
BR2_TOOLCHAIN_BUILDROOT_CXX=y
BR2_TARGET_GENERIC_HOSTNAME="udoo-neo"
BR2_TARGET_GENERIC_ISSUE="Welcome to UDOO Neo"
BR2_ROOTFS_DEVICE_CREATION_DYNAMIC_MDEV=y
BR2_SYSTEM_DHCP="eth0"
BR2_ROOTFS_OVERLAY="$(BR2_EXTERNAL_NEO_BLD_PATH)/board/udoo/neo_common/overlay $(BR2_EXTERNAL_NEO_BLD_PATH)/board/udoo/neo_latest/overlay"
BR2_ROOTFS_POST_BUILD_SCRIPT="$(BR2_EXTERNAL_NEO_BLD_PATH)/board/udoo/neo_common/post-build.sh"
BR2_ROOTFS_POST_IMAGE_SCRIPT="$(BR2_EXTERNAL_NEO_BLD_PATH)/board/udoo/neo_common/post-image.sh"
BR2_LINUX_KERNEL=y
BR2_LINUX_KERNEL_CUSTOM_VERSION=y
BR2_LINUX_KERNEL_CUSTOM_VERSION_VALUE="4.9"
BR2_LINUX_KERNEL_USE_CUSTOM_CONFIG=y
BR2_LINUX_KERNEL_CUSTOM_CONFIG_FILE="$(BR2_EXTERNAL_NEO_BLD_PATH)/board/udoo/neo_latest/kernel.config"
BR2_LINUX_KERNEL_DTS_SUPPORT=y
BR2_LINUX_KERNEL_INTREE_DTS_NAME="imx6sx-udoo-neo-basic imx6sx-udoo-neo-full imx6sx-udoo-neo-extended"
BR2_LINUX_KERNEL_INSTALL_TARGET=y
BR2_PACKAGE_BUSYBOX_SHOW_OTHERS=y
BR2_PACKAGE_LINUX_FIRMWARE=y
BR2_PACKAGE_LINUX_FIRMWARE_TI_WL18XX=y
BR2_PACKAGE_MINICOM=y
BR2_PACKAGE_NANOCOM=y
BR2_PACKAGE_RFKILL=y
BR2_PACKAGE_PYTHON3_CURSES=y
BR2_PACKAGE_PYTHON3_PYEXPAT=y
BR2_PACKAGE_PYTHON3_ZLIB=y
BR2_PACKAGE_LIBRTLSDR=y
BR2_PACKAGE_BLUEZ_UTILS=y
BR2_PACKAGE_DROPBEAR=y
BR2_PACKAGE_IW=y
BR2_PACKAGE_NETCAT=y
BR2_PACKAGE_WIRELESS_REGDB=y
BR2_PACKAGE_WIRELESS_TOOLS=y
BR2_PACKAGE_WPA_SUPPLICANT=y
BR2_PACKAGE_WPA_SUPPLICANT_PASSPHRASE=y
BR2_PACKAGE_BASH=y
BR2_TARGET_ROOTFS_EXT2=y
BR2_TARGET_ROOTFS_EXT2_4=y
BR2_TARGET_UBOOT=y
BR2_TARGET_UBOOT_BOARDNAME="udoo_neo"
BR2_TARGET_UBOOT_CUSTOM_VERSION=y
BR2_TARGET_UBOOT_CUSTOM_VERSION_VALUE="2017.01"
BR2_TARGET_UBOOT_FORMAT_IMG=y
BR2_TARGET_UBOOT_SPL=y
BR2_TARGET_UBOOT_SPL_NAME="SPL"
BR2_PACKAGE_HOST_DOSFSTOOLS=y
BR2_PACKAGE_HOST_GENIMAGE=y
BR2_PACKAGE_HOST_MTOOLS=y
BR2_PACKAGE_HOST_UBOOT_TOOLS=y
BR2_PACKAGE_DUMP1090=y
BR2_PACKAGE_KALIBRATE_RTL=y
BR2_PACKAGE_ACARSDEC=y
BR2_PACKAGE_MLAT_CLIENT=y
```

## package/acarsdec/Config.in
```kconfig
config BR2_PACKAGE_ACARSDEC
    bool 'acarsdec'
    select BR2_PACKAGE_SQLITE
    depends on BR2_PACKAGE_LIBRTLSDR
    depends on BR2_TOOLCHAIN_HAS_THREADS
    help
        ACARS Decoder and Server designed for RTLSDR devices.
        https://github.com/TLeconte/acarsdec
```

## package/mlat-client/Config.in
```kconfig
config BR2_PACKAGE_MLAT_CLIENT
    bool 'mlat-client'
    select BR2_PACKAGE_PYTHON3
    help
        MLAT client for performing multilateration calculations from
        dump1090 outputs.
        https://github.com/mutability/mlat-client
```

## package/udoo-neo-scripts/Config.in
```kconfig
config BR2_PACKAGE_UDOO_NEO_SCRIPTS
    bool 'udoo neo scripts'
    help
        Scripts for testing and setting up the Udoo Neo board.

if BR2_PACKAGE_UDOO_NEO_SCRIPTS

config BR2_PACKAGE_UDOO_NEO_TEST_SCRIPTS
    bool 'test scripts'
    depends on BR2_PACKAGE_BASH
    help
        Perform self test of UDOO board from userspace.

comment "test scripts require bash"
    depends on !BR2_PACKAGE_BASH

config BR2_PACKAGE_UDOO_NEO_RESIZE_ROOTFS
    bool 'resize rootfs'
    depends on BR2_PACKAGE_E2FSPROGS_RESIZE2FS
    depends on BR2_INIT_SYSV || BR2_INIT_BUSYBOX
    help
        On first boot, will resize image to use all available space.

comment "resize rootfs requires resize2fs"
    depends on !BR2_PACKAGE_E2FSPROGS_RESIZE2FS
    depends on BR2_INIT_SYSV || BR2_INIT_BUSYBOX

endif
```

## package/virtualradar/Config.in
```kconfig
source "$BR2_EXTERNAL_NEO_BLD_PATH/package/virtualradar/virtualradar/Config.in"

if BR2_PACKAGE_VIRTUALRADAR
config BR2_PACKAGE_VIRTUALRADAR_SERVICE
    bool 'run as service'
    depends on BR2_INIT_SYSV || BR2_INIT_BUSYBOX
    help
        Starts VRS on startup in headless mode. Note, you will need to
        configure the Admin interface manually once via CLI.

source "$BR2_EXTERNAL_NEO_BLD_PATH/package/virtualradar/virtualradar-admin/Config.in"
source "$BR2_EXTERNAL_NEO_BLD_PATH/package/virtualradar/virtualradar-db-writer/Config.in"
source "$BR2_EXTERNAL_NEO_BLD_PATH/package/virtualradar/virtualradar-db-editor/Config.in"
source "$BR2_EXTERNAL_NEO_BLD_PATH/package/virtualradar/virtualradar-custom-content/Config.in"
endif

comment "Virtual Radar requires Mono and libgdiplus"
    depends on !BR2_PACKAGE_MONO || !BR2_PACKAGE_LIBGDIPLUS
```

## package/virtualradar/virtualradar-admin/Config.in
```kconfig
config BR2_PACKAGE_VIRTUALRADAR_ADMIN
    bool 'Web Admin Plugin'
    help
        Provides web interface for configuring VRS.
        http://virtualradarserver.co.uk
```

## package/virtualradar/virtualradar-custom-content/Config.in
```kconfig
config BR2_PACKAGE_VIRTUALRADAR_CUSTOM_CONTENT
    bool 'Custom Content Plugin'
    help
        Provides ability to edit webpage contents for VRS.
        http://virtualradarserver.co.uk
```

## package/virtualradar/virtualradar-db-editor/Config.in
```kconfig
config BR2_PACKAGE_VIRTUALRADAR_DB_EDITOR
    bool 'DB Editor Plugin'
    help
        Provides ability to edit database for VRS.
        http://virtualradarserver.co.uk
```

## package/virtualradar/virtualradar-db-writer/Config.in
```kconfig
config BR2_PACKAGE_VIRTUALRADAR_DB_WRITER
    bool 'DB Writer Plugin'
    help
        Provides ability to write database for VRS.
        http://virtualradarserver.co.uk
```

## package/virtualradar/virtualradar/Config.in
```kconfig
config BR2_PACKAGE_VIRTUALRADAR
    bool 'vrs'
    depends on BR2_PACKAGE_MONO
    depends on BR2_PACKAGE_LIBGDIPLUS
    help
        Virtual Radar Server package. Executes using the Mono package.
        Integrates with dump1090 and/or MLAT to serve up ADS-B Map.
        http://virtualradarserver.co.uk
```
